## conf/layer.conf
```bitbake
# We have a conf and classes directory, append to BBPATH
BBPATH .= ":${LAYERDIR}"

# We have a recipes directory, add to BBFILES
BBFILES += "${LAYERDIR}/recipes*/*/*.bb ${LAYERDIR}/recipes*/*/*.bbappend ${LAYERDIR}/images/*.bb"

BBFILE_COLLECTIONS += "meta-moddevices-contrib"
BBFILE_PATTERN_meta-moddevices-contrib := "^${LAYERDIR}/"
BBFILE_PRIORITY_meta-moddevices-contrib = "9"

LAYERDEPENDS_meta-moddevices-contrib = " \
    core \
    openembedded-layer \
"

HOSTTOOLS += " 7z msgfmt intltool-merge"

PREFERRED_VERSION_fluidsynth ?= "1.1.6"
PREFERRED_VERSION_python3-tornado ?= "4.5.2"

LV2_DIR ?= "/usr/lib/lv2"
LV2_DIR_BAD ?= "/usr/lib/lv2-bad"
```
